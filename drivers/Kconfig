## drivers/servo/Kconfig
```kconfig
config SERVO
	bool "UMD Loop servo driver"
	default y
	depends on DT_HAS_UMDLOOP_SERVO_ENABLED
	select PWM
	help
	  Positions a hobby servo using a 50 Hz PWM signal.

config SERVO_INIT_PRIORITY
	int "Servo init priority"
	default 80
	depends on SERVO
```

## dts/bindings/umdloop,pwm-servo.yaml
```yaml
description: Hobby servo driven by 50 Hz PWM (UMD Loop E2 System Two)

compatible: "umdloop,servo"

include: base.yaml

properties:
  pwms:
    type: phandle-array
    required: true
    description: PWM channel driving the servo signal wire

  min-pulse-us:
    type: int
    default: 544
    description: Pulse width in microseconds for 0 degrees

  max-pulse-us:
    type: int
    default: 2400
    description: Pulse width in microseconds for 180 degrees
```

## dts/bindings/umdloop,pwm-speaker.yaml
```yaml
description: Passive buzzer driven by a PWM square wave (UMD Loop E2 System Three)

compatible: "umdloop,pwm-speaker"

include: base.yaml

properties:
  pwms:
    type: phandle-array
    required: true
    description: PWM channel driving the buzzer
```
